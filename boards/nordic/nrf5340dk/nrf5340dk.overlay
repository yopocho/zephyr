/*
 * Copyright (c) 2024 Niels van der Zijden <nielsvanderzijden@lumiad.com>
 *
 * SPDX-License-Identifier: Apache-2.0
 */

&spi0 {
    s2lp0: s2lp@1 {
        status = "okay";
        compatible = "st,s2-lp";
        reg = <1>;
        spi-max-frequency = <1000000>;
        sdn-gpios = <&gpio1 2 GPIO_ACTIVE_LOW>;
        interrupt-gpios = <&gpio0 3 GPIO_ACTIVE_LOW>;
        interrupts = <3 NRF_DEFAULT_IRQ_PRIORITY>;
    };
};